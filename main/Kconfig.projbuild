## main/Kconfig.projbuild
```kconfig
menu "Example Configuration"

    config ESP_DEVICE_NAME
        string "Device Name"
        default "ESP"
        help
            Default device name (For Alexa etc.)

    config ESP_WIFI_SSID
        string "WiFi SSID"
        default "myssid"
        help
            SSID (network name) for the example to connect to.

    config ESP_WIFI_PASSWORD
        string "WiFi Password"
        default "mypassword"
        help
            WiFi password (WPA or WPA2) for the example to use.

    config ESP_MAXIMUM_RETRY
        int "Maximum retry"
        default 5
        help
            Set the Maximum retry to avoid station reconnecting to the AP unlimited when the AP is really inexistent.

    config ESP_SYSLOG_SERVER
        string "Syslog Server IP"
        default ""
        help
            Set the remote syslog server IP address.

    config ESP_REDIRECT_STDOUT_SYSLOG
        bool "Redirect all output to syslog"
        default 0
endmenu
```
